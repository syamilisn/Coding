/plugin/;

/{
	fragment@0{
		target = <&i2c1>;
		__overlay__ {
			ssd1306_i2c:oled@3c {
				compatible="solomon,ssd1306fb-i2c";
				reg=<0x3C>;
                		width=<128>;
                		height=<64>;
				status="okay";
			};
		};
	};
};
